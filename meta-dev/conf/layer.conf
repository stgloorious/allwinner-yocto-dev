## meta-dev/conf/layer.conf
```bitbake
# We have a conf and classes directory, add to BBPATH
BBPATH .= ":${LAYERDIR}"

# We have recipes-* directories, add to BBFILES
BBFILES += "${LAYERDIR}/recipes-*/*/*.bb \
            ${LAYERDIR}/recipes-*/*/*.bbappend"

BBFILE_COLLECTIONS += "meta-dev"
BBFILE_PATTERN_meta-dev = "^${LAYERDIR}/"
BBFILE_PRIORITY_meta-dev = "12"

LAYERDEPENDS_meta-dev = " \
    meta-arm \
    arm-toolchain \
    sunxi \
    openembedded-layer \
    meta-python \
"
LAYERSERIES_COMPAT_meta-dev = "styhead"
```
